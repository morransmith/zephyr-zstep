/* SPDX-License-Identifier: Apache-2.0 */

#include <zephyr/dt-bindings/gpio/gpio.h>

/ {
	aliases {
		stepper = &motor;
	};

	motor: motor {
		compatible = "zstep,step-dir";
		step-gpios = <&gpio0 0 GPIO_ACTIVE_HIGH>;
		dir-gpios = <&gpio0 1 GPIO_ACTIVE_HIGH>;
		counter = <&counter0>;
	};
};
