## drivers/stepper/Kconfig
```kconfig
# SPDX-License-Identifier: Apache-2.0

config ZSTEP_RAMP
	bool
	select REQUIRES_FULL_LIBC
	help
	  Integer trapezoidal ramp generator and input shaper used by the zstep drivers.

config ZSTEP_STEP_DIR
	bool "Ramped step/dir stepper motion controller"
	default y
	depends on STEPPER && DT_HAS_ZSTEP_STEP_DIR_ENABLED
	select COUNTER
	select GPIO
	select STEPPER_CTRL_EVENT_HANDLER
	select ZSTEP_RAMP
	help
	  Step/dir motion controller with acceleration ramps. Each motor uses its own
	  channel of a shared hardware counter, so motors never disturb each other's timing.

if ZSTEP_STEP_DIR

config ZSTEP_GROUP_MAX_AXES
	int "Maximum number of axes in a synchronized group move"
	default 6
	range 1 32

config ZSTEP_GROUP_START_US
	int "Delay before the first step of a synchronized group move [us]"
	default 50
	help
	  Every axis of the group is armed for the same counter tick this far in the future.
	  It must cover the time needed to arm all axes.

endif # ZSTEP_STEP_DIR
```

## dts/bindings/stepper/zstep,step-dir.yaml
```yaml
# SPDX-License-Identifier: Apache-2.0

description: |
  Step/dir stepper motion controller with trapezoidal acceleration ramps.

  Every edge is scheduled by a hardware counter alarm, so no CPU time is spent
  waiting. Several motors may share one counter, each using its own channel; their
  timing stays independent because every motor keeps its own time grid.

  The counter must be free running, count over a power-of-two range and allow
  re-arming a channel from its own alarm callback.

compatible: "zstep,step-dir"

include:
  - name: step-dir-timing.yaml

properties:
  step-gpios:
    type: phandle-array
    required: true
    description: Step signal output.

  dir-gpios:
    type: phandle-array
    required: true
    description: |
      Direction signal output. Driven active for the positive direction.

  invert-direction:
    type: boolean
    description: Swap the positive and negative directions.

  counter:
    type: phandle
    required: true
    description: Hardware counter providing the time base.

  counter-channel:
    type: int
    default: 0
    description: |
      Alarm channel of the counter used by this motor. Motors sharing a counter
      must use different channels.

  stepper-driver:
    type: phandle
    description: |
      Optional stepper driver chip. Its step-width-ns and dual-edge-step properties
      take precedence over the ones of this node.

  step-width-ns:
    default: 2000

  dual-edge-step:
    type: boolean
    description: |
      The driver steps on both edges of the step signal, halving the interrupt rate.

  dir-setup-ns:
    type: int
    default: 650
    description: |
      Minimum time between a direction change and the next step edge.

  input-shaper:
    type: string
    enum:
      - "none"
      - "zv"
      - "zvd"
      - "ei"
    description: |
      Input shaper cancelling a resonance of the axis. ZVD suits an accurately measured
      frequency, EI tolerates a larger error. Needs input-shaper-buffer-steps.

  input-shaper-frequency-centihz:
    type: int
    description: Resonance frequency in 0.01 Hz, e.g. 4250 for 42.5 Hz.

  input-shaper-damping-permille:
    type: int
    default: 100
    description: Damping ratio of the resonance in 0.001 units, at most 300 for EI.

  input-shaper-buffer-steps:
    type: int
    description: |
      Commanded steps kept for the delayed impulses, 8 bytes each. It must cover the
      shaper duration at full speed, e.g. 1100 for EI at 40 Hz and 40000 steps/s.

examples:
  - |
    x_axis: x-axis {
        compatible = "zstep,step-dir";
        step-gpios = <&gpioa 0 GPIO_ACTIVE_HIGH>;
        dir-gpios = <&gpioa 1 GPIO_ACTIVE_HIGH>;
        counter = <&counter2>;
        counter-channel = <0>;
        stepper-driver = <&x_driver>;
    };
```

## tests/integration/conformance/Kconfig
```kconfig
# SPDX-License-Identifier: Apache-2.0

source "$(ZEPHYR_BASE)/tests/drivers/stepper/stepper_ctrl/Kconfig"
```

## tests/integration/conformance/testcase.yaml
```yaml
# SPDX-License-Identifier: Apache-2.0

common:
  tags:
    - drivers
    - stepper
  platform_allow:
    - native_sim
    - native_sim/native/64
  integration_platforms:
    - native_sim/native/64
tests:
  zstep.integration.conformance.counter_1khz: {}
  zstep.integration.conformance.counter_1mhz:
    extra_configs:
      - CONFIG_COUNTER_NATIVE_SIM_FREQUENCY=1000000
  zstep.integration.conformance.direct_events:
    extra_configs:
      - CONFIG_COUNTER_NATIVE_SIM_FREQUENCY=1000000
      - CONFIG_STEPPER_CTRL_ISR_SAFE_EVENTS=n
  zstep.integration.conformance.zvd:
    extra_args:
      - EXTRA_DTC_OVERLAY_FILE="zvd.overlay"
    extra_configs:
      - CONFIG_COUNTER_NATIVE_SIM_FREQUENCY=1000000
  zstep.integration.conformance.ei:
    extra_args:
      - EXTRA_DTC_OVERLAY_FILE="ei.overlay"
    extra_configs:
      - CONFIG_COUNTER_NATIVE_SIM_FREQUENCY=1000000
```

## tests/integration/timing/testcase.yaml
```yaml
# SPDX-License-Identifier: Apache-2.0

common:
  tags:
    - drivers
    - stepper
  platform_allow:
    - native_sim
    - native_sim/native/64
  integration_platforms:
    - native_sim/native/64
tests:
  zstep.integration.timing: {}
  zstep.integration.timing.direct_events:
    extra_configs:
      - CONFIG_STEPPER_CTRL_ISR_SAFE_EVENTS=n
```

## tests/unit/ramp/Kconfig
```kconfig
# SPDX-License-Identifier: Apache-2.0

mainmenu "zstep ramp test"

source "Kconfig.zephyr"

config TEST_ZSTEP_RAMP
	bool
	default y
	select ZSTEP_RAMP
```

## tests/unit/ramp/testcase.yaml
```yaml
# SPDX-License-Identifier: Apache-2.0

tests:
  zstep.unit.ramp:
    tags:
      - stepper
    platform_allow:
      - native_sim
      - native_sim/native/64
    integration_platforms:
      - native_sim/native/64
```
